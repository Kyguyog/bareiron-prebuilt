## sdkconfig.defaults
```kconfig
CONFIG_ESPTOOLPY_FLASHSIZE_16MB=y
CONFIG_ESPTOOLPY_FLASHSIZE="16MB"
CONFIG_SPIRAM=y
CONFIG_SPIRAM_MODE_OCT=y
CONFIG_SPIRAM_TYPE_ESPPSRAM64=y
CONFIG_SPIRAM_SPEED_80M=y
CONFIG_SPIRAM_USE_MALLOC=y
CONFIG_ESP_PHY_MAX_WIFI_TX_POWER=10
CONFIG_ESP_PHY_MAX_TX_POWER=10
CONFIG_ESP_PHY_REDUCE_TX_POWER=y
# CONFIG_ESP_BROWNOUT_DET is not set
CONFIG_ESP_PHY_RF_CAL_NONE=y
CONFIG_ESP_PHY_CALIBRATION_MODE=1
```
